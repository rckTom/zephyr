## drivers/sensor/aisx120sx/Kconfig
```kconfig
# AISx120SX single or dual channel accleration sensor

# Copyright (c) 2019 Thomas Schmid <tom@lfence.de>
# SPDX-License-Identifier: Apache-2.0

menuconfig AISX120SX
	bool "AISx120SX single or dual channel acceleration sensor"
	depends on SPI
	help
	  Enable driver for AISx120SC single or dual channel acceleration
	  sensor.

if AISX120SX

config AISX120SX_DISABLE_OFF_MON_X
	bool "Disable offset monitoring channel x"
	help
	  Disable offset monitoring in x direction.

config AISC120SX_DISABLE_OFF_MON_Y
	bool "Disable offset monitoring channel y"
	help
	  Disable offset monitoring in y direction. This option only has an
	  effect if the dual channel version of the chip is used

config AISX120SX_DISABLE_OFF_CANC_X
	bool "Disable offset cancellation channel x"
	help
	  Disables offset cancellation in x direction.

config AISX120SX_DISABLE_OFF_CANC_Y
	bool "Disable offset cancellation channel y"
	help
	  Disables offset cancellation in y direction. This option only has an
	  effect if the dual channel version of the chip is used


choice AISX120SX_BW_CHANNEL_X
	prompt "Bandwidth channel x"
	help
	 Cut off frequency of the integrated fir filter.

config AISX120SX_BW_CHANNEL_X_400
	bool "400 Hz"

config AISX120SX_BW_CHANNEL_X_800
	bool "800 Hz"

config AISX120SX_BW_CHANNEL_X_1600
	bool "1600Hz"

endchoice


choice AISX120SX_BW_CHANNEL_Y
	prompt "Bandwidth channel y"
	help
	 Cut off frequency of the integrated fir filter. Only has an effect if
	 the dual channel version of the chip is used.

config AISX120SX_BW_CHANNEL_Y_400
	bool "400 Hz"

config AISX120SX_BW_CHANNEL_Y_800
	bool "800 Hz"

config AISX120SX_BW_CHANNEL_Y_1600
	bool "1600Hz"

endchoice

endif # AISX120SX
```

## drivers/sensor/bmi088_accel/Kconfig
```kconfig
# Kconfig - Bosch BMI088 inertial measurement configuration options

#
# Copyright (c) 2016 Intel Corporation
#
# SPDX-License-Identifier: Apache-2.0
#

menuconfig BMI088_ACCEL
	bool "Bosch BMI088 inertial measurement unit accelerometer driver"
	depends on SPI
	help
	  Enable accelerometer of the Bosch BMI088 inertial measurement unit

if BMI088_ACCEL

choice
	prompt "Accelerometer range setting"
	default BMI088_ACCEL_RANGE_24G

config BMI088_ACCEL_RANGE_3G
	bool "3G"

config BMI088_ACCEL_RANGE_6G
	bool "6G"

config BMI088_ACCEL_RANGE_12G
	bool "12G"

config BMI088_ACCEL_RANGE_24G
	bool "24G"
endchoice

choice
	prompt "Accelerometer bandwidth setting"
	default BMI088_ACCEL_BANDWITH_OSR_1

config BMI088_ACCEL_BANDWITH_OSR_1
	bool "OSR 1"

config BMI088_ACCEL_BANDWITH_OSR_2
	bool "OSR 2"

config BMI088_ACCEL_BANDWITH_OSR_4
	bool "OSR 4"
endchoice

choice
	prompt "Accelerometer sampling frequency."
	default BMI088_ACCEL_ODR_200

config BMI088_ACCEL_ODR_25_2
	bool "12.5 Hz"

config BMI088_ACCEL_ODR_25
	bool "25 Hz"

config BMI088_ACCEL_ODR_50
	bool "50 Hz"

config BMI088_ACCEL_ODR_100
	bool "100 Hz"

config BMI088_ACCEL_ODR_200
	bool "200 Hz"

config BMI088_ACCEL_ODR_400
	bool "400 Hz"

config BMI088_ACCEL_ODR_800
	bool "800 Hz"

config BMI088_ACCEL_ODR_1600
	bool "1600 Hz"
endchoice

endif # BMI088_ACCEL
```

## drivers/sensor/bmi088_gyro/Kconfig
```kconfig
# Kconfig - Bosch BMI088 Gyro inertial measurement configuration options

#
# Copyright (c) 2016 Intel Corporation
#
# SPDX-License-Identifier: Apache-2.0
#

menuconfig BMI088_GYRO
	bool "Bosch BMI088 inertial measurement unit gyro driver"
	depends on SPI
	help
	  Enable gyro of the Bosch BMI088 inertial measurement unit

if BMI088_GYRO

choice
	prompt "Gyroscope range setting."
	default BMI088_GYRO_RANGE_500DPS

config BMI088_GYRO_RANGE_2000DPS
	bool "2000 DPS"

config BMI088_GYRO_RANGE_1000DPS
	bool "1000 DPS"

config BMI088_GYRO_RANGE_500DPS
	bool "500 DPS"

config BMI088_GYRO_RANGE_250DPS
	bool "250 DPS"

config BMI088_GYRO_RANGE_125DPS
	bool "125 DPS"
endchoice

choice
	prompt "Gyroscope sampling frequency."
	default BMI088_GYRO_ODR_1000_BW_116

config BMI088_GYRO_ODR_2000_BW_532
	bool "ODR 2000 Hz, Bandwidth 532 Hz"

config BMI088_GYRO_ODR_2000_BW_230
	bool "ODR 2000 Hz, Bandwidth 230 Hz"

config BMI088_GYRO_ODR_1000_BW_116
	bool "ODR 1000 Hz, Bandwidth 116 Hz"

config BMI088_GYRO_ODR_400_BW_47
	bool "ODR 400 Hz, Bandwidth 47 Hz"

config BMI088_GYRO_ODR_200_BW_23
	bool "ODR 200 Hz, Bandwidth 23 Hz"

config BMI088_GYRO_ODR_100_BW_64
	bool "ODR 200 Hz, Bandwidth 64 Hz"

config BMI088_GYRO_ODR_100_BW_32
	bool "ODR 100 Hz, Bandwidth 32 Hz"

config BMI088_GYRO_ODR_100_BW_12
	bool "ODR 100 Hz, Bandwidth 12 Hz"
endchoice

endif # BMI088_GYRO
```

## dts/bindings/sensor/bosch,bmi088-accel-spi.yaml
```yaml
# Copyright (c) 2018, Linaro Limited
# SPDX-License-Identifier: Apache-2.0

title: BMI088 Inertial measurement unit

description: >
    This is a representation of the BMI088 acceleration sensor

compatible: "bosch,bmi088-accel"

include: spi-device.yaml

properties:
    int-gpios:
      type: phandle-array
      required: false
```

## dts/bindings/sensor/bosch,bmi088-gyro-spi.yaml
```yaml
# Copyright (c) 2018, Linaro Limited
# SPDX-License-Identifier: Apache-2.0

description: |
    Gyro sensor of the Bosch BMI088 inertial measurement unit

compatible: "bosch,bmi088-gyro"

include: spi-device.yaml

properties:
    int-gpios:
      type: phandle-array
      required: false
```

## dts/bindings/sensor/st,aisx120sx.yaml
```yaml
# Copyright (c) 2019, Thomas Schmid <tom@lfence.de>
# SPDX-License-Identifier: Apache-2.0

description: |
    ST Microelectronics acceleration sensor

compatible: "st,aisx120sx"

include: spi-device.yaml
```
